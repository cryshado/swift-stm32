# STM32MP157 register map
File version: 1.7
STM32MP157x
CPU: CM4 r0p1, little endian, no MPU, FPU, 4 interrupt priority bits
Registers are 32-bit, read-write, reset 0x0 unless marked. A register's access mark holds for its fields unless they carry their own. Offsets are from the block's base; lines under a group give offsets from that group; [hi:lo] are bit positions; {n}, {i} and the like mark numbered series; 'fields as' and 'values as' point back to an identical list; <NAME> marks a mode.

## Memory map
0x40000000 TIM2 size 0x400
0x40001000 TIM3 size 0x400
0x40002000 TIM4 size 0x400
0x40003000 TIM5 size 0x400
0x40004000 TIM6 size 0x400
0x40005000 TIM7 size 0x400
0x40006000 TIM12 size 0x400
0x40007000 TIM13 size 0x400
0x40008000 TIM14 size 0x400
0x40009000 LPTIM1 size 0x400
0x4000A000 WWDG1 size 0x400
0x4000B000 SPI2 size 0x400
0x4000C000 SPI3 size 0x400
0x4000D000 SPDIFRX size 0x400
0x4000E000 USART2 size 0x400
0x4000F000 USART3 size 0x400
0x40010000 USART4 size 0x400
0x40011000 USART5 size 0x400
0x40012000 I2C1 size 0x400
0x40013000 I2C2 size 0x400
0x40014000 I2C3 size 0x400
0x40015000 I2C5 size 0x400
0x40016000 HDMI_CEC size 0x400
0x40017000 DAC1 size 0x400
0x40018000 USART7 size 0x400
0x40019000 USART8 size 0x400
0x4001C000 MDIOS size 0x400
0x44000000 TIM1 size 0x400
0x44001000 TIM8 size 0x400
0x44003000 USART6 size 0x400
0x44004000 SPI1 size 0x400
0x44005000 SPI4 size 0x400
0x44006000 TIM15 size 0x400
0x44007000 TIM16 size 0x400
0x44008000 TIM17 size 0x400
0x44009000 SPI5 size 0x400
0x4400A000 SAI1 size 0x400 — SAI1 register block
0x4400B000 SAI2 size 0x400
0x4400C000 SAI3 size 0x400
0x4400D000 DFSDM1 size 0x800
0x4400E000 FDCAN1 size 0x400
0x4400F000 FDCAN2 size 0x400
0x44010000 CCU size 0x400
0x48000000 DMA1 size 0x400
0x48001000 DMA2 size 0x400
0x48002000 DMAMUX1 size 0x400
0x48003000 ADC size 0x100
0x48003100 ADC2 size 0x100
0x48003300 ADC_common size 0x100 — Analog-to-Digital Converter
0x48004000 SDMMC3 size 0x1000
0x48005000 DLYBSD3 size 0x1000
0x49000000 OTG size 0x1000
0x4C000000 HSEM size 0x400
0x4C001000 IPCC size 0x400
0x4C002000 HASH2 size 0x400 — HASH register block
0x4C003000 RNG2 size 0x400
0x4C004000 CRC2 size 0x1000
0x4C005000 CRYP2 size 0x400
0x4C006000 DCMI size 0x400
0x50000000 RCC size 0x1000
0x50001000 PWR size 0x400
0x50002000 GPIOA size 0x400
0x50003000 GPIOB size 0x400
0x50004000 GPIOC size 0x400
0x50005000 GPIOD size 0x400
0x50006000 GPIOE size 0x400
0x50007000 GPIOF size 0x400
0x50008000 GPIOG size 0x400
0x50009000 GPIOH size 0x400
0x5000A000 GPIOI size 0x400
0x5000B000 GPIOJ size 0x400
0x5000C000 GPIOK size 0x400
0x5000D000 EXTI size 0x400
0x50020000 SYSCFG size 0x400
0x50021000 LPTIM2 size 0x400
0x50022000 LPTIM3 size 0x400
0x50023000 LPTIM4 size 0x400
0x50024000 LPTIM5 size 0x400
0x50025000 VREFBUF size 0x400
0x50027000 SAI4 size 0x400
0x50028000 DTS size 0x400 — DTS register block
0x5002A000 HDP size 0x400
0x54001000 CRYP1 size 0x400
0x54002000 HASH1 size 0x400 — HASH register block
0x54003000 RNG1 size 0x400
0x54004000 GPIOZ size 0x400
0x57042024 AXIMC_Mx size 0x100000
0x58000000 MDMA size 0x1000 — MDMA1
0x58002000 FMC size 0x1000 — FMC register block
0x58003000 QUADSPI size 0x1000 — QUADSPI1
0x58004000 DLYBQS size 0x1000
0x58005000 SDMMC1 size 0x1000
0x58006000 DLYBSD1 size 0x1000
0x58007000 SDMMC2 size 0x1000
0x58008000 DLYBSD2 size 0x1000
0x58009000 CRC1 size 0x1000
0x5800A000 ETH_MAC_MMC size 0xBD4
0x5800AC00 ETH_MTL size 0x400
0x5800B000 ETH_DMA size 0x400
0x5A000000 DSI size 0x800 — DSIHOST1
0x5A001000 LTDC size 0x400
0x5A002000 IWDG2 size 0x400
0x5A003000 DDRCTRL size 0x1000
0x5A004000 DDRPHYC size 0x1000
0x5A005000 STGENR size 0x1000
0x5A006000 USBPHYC size 0x1000
0x5A007000 DDRPERFM size 0x400
0x5C000000 USART1 size 0x400 — Universal synchronous asynchronous receiver transmitter
0x5C001000 SPI6 size 0x400
0x5C002000 I2C4 size 0x400
0x5C003000 IWDG1 size 0x400
0x5C004000 RTC size 0x400
0x5C005000 BSEC size 0x1000 — BSEC2
0x5C006000 TZC size 0x1000
0x5C007000 ETZPC size 0x400
0x5C008000 STGENC size 0x1000
0x5C009000 I2C6 size 0x400
0x5C00A000 TAMP size 0x400
0xA0021000 GICD size 0x1000
0xA0022000 GICC size 0x2000
0xA0024000 GICH size 0x2000
0xA0026000 GICV size 0x2000
0xE000E100 NVIC size 0x401 — Nested Vectored Interrupt Controller

## Interrupts
0 WWDG1_IT (WWDG1) — Window Watchdog interrupt
1 PVD_AVD (EXTI) — PVD AND AVD detector through EXTI
2 TAMP — Tamper interrupt (include LSECSS interrupts)
3 RTC_WKUP_ALARM (RTC) — RTC Tamper or TimeStamp
4 TZC_IT (TZC) — TrustZone DDR address space controller
5 RCC — RCC global interrupt
6 EXTI0 (EXTI) — EXTI Line 0 interrupt
7 EXTI1 (EXTI) — EXTI Line 1 interrupt
8 EXTI2 (EXTI) — EXTI Line 2 interrupt
9 EXTI3 (EXTI) — EXTI Line 3 interrupt
10 EXTI4 (EXTI) — EXTI Line 4 interrupt
11 DMA1_STR0 (DMA1) — DMA1 stream0 global interrupt
12 DMA1_STR1 (DMA1) — DMA1 stream1 global interrupt
13 DMA1_STR2 (DMA1) — DMA1 stream2 global interrupt
14 DMA1_STR3 (DMA1) — DMA1 stream3 global interrupt
15 DMA1_STR4 (DMA1) — DMA1 stream4 global interrupt
16 DMA1_STR5 (DMA1) — DMA1 stream5 global interrupt
17 DMA1_STR6 (DMA1) — DMA1 stream6 global interrupt
18 ADC1 (ADC) — ADC1 global interrupt
19 FDCAN1_IT0 (FDCAN1) — FDCAN1 interrupt 0
20 FDCAN2_IT0 (FDCAN2) — FDCAN2 interrupt 0
21 FDCAN1_IT1 (FDCAN1) — FDCAN1 interrupt 1
22 FDCAN2_IT1 (FDCAN2) — FDCAN2 interrupt 1
23 EXTI5 (EXTI) — EXTI line 5 interrupt
24 TIM1_BRK (TIM1) — TIM1 break interrupt
25 TIM1_UP (TIM1) — TIM1 update interrupt
26 TIM1_TRG_COM (TIM1) — TIM1 trigger and commutation interrupt
27 TIM1_CC (TIM1) — TIM1 capture compare interrupt
28 TIM2 — TIM2 global interrupt
29 TIM3 — TIM3 global interrupt
30 TIM4 — TIM4 global interrupt
31 I2C1_EVT (I2C1) — I2C1 event interrupt
32 I2C1_ERR (I2C1) — I2C1 global error interrupt
33 I2C2_EVT (I2C2) — I2C2 event interrupt
34 I2C2_ERR (I2C2) — I2C2 global error interrupt
35 SPI1 — SPI1 global interrupt
36 SPI2 — SPI2 global interrupt
37 USART1 — USART1 global interrupt
38 USART2 — USART2 global interrupt
39 USART3 — USART3 global interrupt
40 EXTI10 (EXTI) — EXTI line 10 interrupt
41 RTC_TS (RTC) — RTC timestamp interrupt
42 EXTI11 (EXTI) — EXTI line 11 interrupt
43 TIM8_BRK (TIM8) — TIM8 break interrupt
44 TIM8_UP (TIM8) — TIM8 update interrupt
45 TIM8_TRG_COM (TIM8) — TIM8 trigger and commutation interrupt
46 TIM8_CC (TIM8) — TIM8 capture compare interrupt
47 DMA1_STR7 (DMA1) — DMA1 stream7 global interrupt
48 FMC — FMC global interrupt
49 SDMMC1 — SDMMC1 global interrupt
50 TIM5 — TIM5 global interrupt
51 SPI3 — SPI3 global interrupt
52 USART4 — USART4 global interrupt
53 USART5 — USART5 global interrupt
54 TIM6 — TIM6 global interrupt
55 TIM7 — TIM7 global interrupt
56 DMA2_STR0 (DMA2) — DMA2 stream0 global interrupt
57 DMA2_STR1 (DMA2) — DMA2 stream1 global interrupt
58 DMA2_STR2 (DMA2) — DMA2 stream2 global interrupt
59 DMA2_STR3 (DMA2) — DMA2 stream3 global interrupt
60 DMA2_STR4 (DMA2) — DMA2 stream4 global interrupt
61 ETH1 (ETH_MAC_MMC) — ETH1 global interrupt
62 ETH1_WKUP (ETH_MAC_MMC) — ETH1 wakeup interrupt
64 EXTI6 (EXTI) — EXTI line 6 interrupt
65 EXTI7 (EXTI) — EXTI line 7 interrupt
66 EXTI8 (EXTI) — EXTI line 8 interrupt
67 EXTI9 (EXTI) — EXTI line 9 interrupt
68 DMA2_STR5 (DMA2) — DMA2 stream5 global interrupt
69 DMA2_STR6 (DMA2) — DMA2 stream6 global interrupt
70 DMA2_STR7 (DMA2) — DMA2 stream7 global interrupt
71 USART6 — USART6 global interrupt
72 I2C3_EVT (I2C3) — I2C3 event interrupt
73 I2C3_ERR (I2C3) — I2C3 global error interrupt
76 EXTI12 (EXTI) — EXTI line 12 interrupt
77 EXTI13 (EXTI) — EXTI line 13 interrupt
78 DCMI — DCMI global interrupt
79 CRYP1 — CRYP1 global interrupt
80 HASH1 — HASH1 interrupt
82 USART7 — USART7 global interrupt
83 USART8 — USART8 global interrupt
84 SPI4 — SPI4 global interrupt
85 SPI5 — SPI5 global interrupt
86 SPI6 — SPI6 global interrupt
87 SAI1 — SAI1 global interrupt
88 LTDC — LTCD global interrupt
89 LTDC_ER (LTDC) — LTCD global error interrupt
90 ADC2 — ADC2 global interrupt
91 SAI2 — SAI2 global interrupt
92 QUADSPI — QUADSPI global interrupt
93 LPTIM1 — LPTIMER1 global interrupt
94 CEC (HDMI_CEC) — HDMI-CEC global interrupt
95 I2C4_EVT (I2C4) — I2C4 event interrupt
96 I2C4_ERR (I2C4) — I2C4 global error interrupt
97 SPDIFRX — SPDIFRX global interrupt
98 OTG — USB On-The-Go global interrupt
100 IPCC_RX0 (IPCC) — IPCC RX0 occupied interrupt
101 IPCC_TX0 (IPCC) — IPCC TX0 free interrupt
102 DMAMUX1_OVR_REQ (DMAMUX1) — DMAMUX1 overrun interrupt
103 IPCC_RX1 (IPCC) — IPCC RX1 occupied interrupt
104 IPCC_TX1 (IPCC) — IPCC TX1 free interrupt
105 CRYP2 — CRYP2 global interrupt
106 HASH2 — HASH2 interrupt
107 I2C5_EVT (I2C5) — I2C5 event interrupt
108 I2C5_ERR (I2C5) — I2C5 global error interrupt
110 DFSDM1_FLT0 (DFSDM1) — DFSDM1 filter0 Interrupt
111 DFSDM1_FLT1 (DFSDM1) — DFSDM1 filter1 Interrupt
112 DFSDM1_FLT2 (DFSDM1) — DFSDM1 filter2 Interrupt
113 DFSDM1_FLT3 (DFSDM1) — DFSDM1 filter3 Interrupt
114 SAI3 — SAI3 global interrupt
115 DFSDM1_FLT4 (DFSDM1) — DFSDM1 filter4 Interrupt
116 TIM15 — TIM15 global interrupt
117 TIM16 — TIM16 global interrupt
118 TIM17 — TIM17 global interrupt
119 TIM12 — TIM12 gloabl interrupt
120 MDIOS — MDIOS global interrupt
121 EXTI14 (EXTI) — EXTI line 14 interrupt
122 MDMA — MDMA global interrupt
123 DSI — DSI Host controller global interrupt
124 SDMMC2 — SDMMC2 global interrupt
125 HSEM_IT2 (HSEM) — HSEM semaphore interrupt 2
126 DFSDM1_FLT5 (DFSDM1) — DFSDM1 filter5 Interrupt
127 EXTI15 (EXTI) — EXTI line 15 interrupt
130 TIM13 — TIM13 global interrupt
131 TIM14 — TIM14 global interrupt
132 DAC (DAC1) — DAC1 and DAC2 underrun error interrupts
133 RNG1 — RNG1 interrupt
134 RNG2 — RNG2 interrupt
135 I2C6_EVT (I2C6) — I2C6 event interrupt
136 I2C6_ERR (I2C6) — I2C6 global error interrupt
137 SDMMC3 — SDMMC3 global interrupt
138 LPTIM2 — LPTIMER2 global interrupt
139 LPTIM3 — LPTIMER3 global interrupt
140 LPTIM4 — LPTIMER4 global interrupt
141 LPTIM5 — LPTIMER5 global interrupt
142 ETH1_LPI (ETH_MAC_MMC) — ETH1 LPI interrupt
145 RCC_WAKEUP (RCC) — RCC MPU wakeup interrupt
146 SAI4 — SAI4 global interrupt
147 DTS — Digital temperature sensor interrupt
150 IWDG1_IT (IWDG1) — IWDG1 early wake
151 IWDG2_IT (IWDG2) — IWDG2 early wake
197 TAMP_S (TAMP) — TAMP tamper secure interrupt
198 RTC_WKUP_ALARM_S (RTC) — RTC wakeup timer and alarms (A and B) secure interrupt
199 RTC_TS_S (RTC) — RTC timestamp secure interrupt
213 DDRPERFM — DDR performance monitor interrupt
