# STM32F301 register map
File version: 1.9
CPU: CM4 r1p0, little endian, MPU, FPU, 4 interrupt priority bits
Registers are 32-bit, read-write, reset 0x0 unless marked. A register's access mark holds for its fields unless they carry their own. Offsets are from the block's base; lines under a group give offsets from that group; [hi:lo] are bit positions; {n}, {i} and the like mark numbered series; 'fields as' and 'values as' point back to an identical list; <NAME> marks a mode.

## Memory map
0x40000000 TIM2 size 0x400 — General purpose timer
0x40001000 TIM6 size 0x400 — Basic timers
0x40002800 RTC size 0x400 — Real-time clock
0x40002C00 WWDG size 0x400 — Window watchdog
0x40003000 IWDG size 0x400 — Independent watchdog
0x40003400 I2S2ext size 0x400
0x40003800 SPI2 size 0x400 — Serial peripheral interface/Inter-IC sound
0x40003C00 SPI3 size 0x400
0x40004000 I2S3ext size 0x400
0x40004400 USART2 size 0x400
0x40004800 USART3 size 0x400
0x40005400 I2C1 size 0x400 — Inter-integrated circuit
0x40005800 I2C2 size 0x400
0x40007000 PWR size 0x400 — Power control
0x40007400 DAC1 size 0x400 — Digital-to-analog converter
0x40007800 I2C3 size 0x400
0x40010000 SYSCFG size 0x400 — System configuration controller
0x40010000 OPAMP size 0x400 — Operational Amplifier
0x40010000 COMP size 0x400 — General purpose comparators
0x40010400 EXTI size 0x400 — External interrupt/event controller
0x40012C00 TIM1 size 0x400 — Advanced-timers
0x40013800 USART1 size 0x400 — Universal synchronous asynchronous receiver transmitter
0x40014000 TIM15 size 0x400 — General purpose timers
0x40014400 TIM16 size 0x400 — General-purpose-timers
0x40014800 TIM17 size 0x400
0x40020000 DMA1 size 0x400 — DMA controller 1
0x40021000 RCC size 0x400 — Reset and clock control
0x40022000 FLASH size 0x400
0x40023000 CRC size 0x400 — cyclic redundancy check calculation unit
0x40024000 TSC size 0x400 — Touch sensing controller
0x48000000 GPIOA size 0x400 — General-purpose I/Os
0x48000400 GPIOB size 0x400 — General-purpose I/Os
0x48000800 GPIOC size 0x400 — General-purpose I/Os
0x48000C00 GPIOD size 0x400
0x48001400 GPIOF size 0x400
0x50000000 ADC1 size 0x400 — Analog to digital converter
0x50000300 ADC1_2 size 0x11 — ADC Common registers
0xE0042000 DBGMCU size 0x400 — Debug support

## Interrupts
0 WWDG_IRQ (WWDG) — Window Watchdog interrupt
1 PVD (PWR) — PVD through EXTI line detection interrupt
2 TAMP_STAMP (EXTI) — Tamper and TimeStamp interrupts
3 RTC_WKUP_IRQ (RTC) — RTC
4 FLASH — Flash global interrupt
5 RCC — RCC global interrupt
6 EXTI0 (EXTI) — EXTI Line0 interrupt
7 EXTI1 (EXTI) — EXTI Line3 interrupt
9 EXTI3 (EXTI) — EXTI Line3 interrupt
10 EXTI4 (EXTI) — EXTI Line4 interrupt
11 DMA1_CH1 (DMA1) — DMA1 channel 1 interrupt
12 DMA1_CH2 (DMA1) — DMA1 channel 2 interrupt
13 DMA1_CH3 (DMA1) — DMA1 channel 3 interrupt
14 DMA1_CH4 (DMA1) — DMA1 channel 4 interrupt
15 DMA1_CH5 (DMA1) — DMA1 channel 5 interrupt
16 DMA1_CH6 (DMA1) — DMA1 channel 6 interrupt
17 DMA1_CH7 (DMA1) — DMA1 channel 7 interrupt
18 ADC1_IRQ (ADC1) — ADC1 interrupt
23 EXTI9_5 (EXTI) — EXTI Line5 to Line9 interrupts
24 TIM15_IRQ (TIM15) — Timer 15 global interrupt
25 TIM16_IRQ (TIM16) — Timer 16 global interrupt
26 TIM17_IRQ (TIM17) — Timer 17 global interrupt
28 TIM2 — Timer 2 global interrupt
31 I2C1_EV_EXTI23 (EXTI) — I2C1 event interrupt and EXTI Line23 interrupt
31 I2C1_EV_IRQ (I2C1) — I2C1_EV global interrupt/EXTI Line[3:2] interrupts
32 I2C1_ER_IRQ (I2C1) — I2C1_ER
33 I2C2_EV_IRQ (I2C2) — I2C2_EV global interrupt/EXTI Line[4:2] interrupts
34 I2C2_ER_IRQ (I2C2) — I2C2_ER
37 USART1_IRQ (USART1) — USART1 global interrupt/EXTI25 (USART1 wakeup event)
38 USART2_EXTI26 (EXTI) — USART2 global interrupt and EXTI Line 26 interrupt
38 USART2_IRQ (USART2) — USART2 global interrupt/EXTI26 (USART1 wakeup event)
39 USART3_EXTI28 (EXTI) — USART3 global interrupt and EXTI Line 28 interrupt
39 USART3_IRQ (USART3) — USART3 global interrupt/EXTI28 (USART1 wakeup event)
40 EXTI15_10 (EXTI) — EXTI Line15 to Line10 interrupts
41 RTC_ALARM_IT_IRQ (RTC) — RTC alarm interrupt
54 TIM6_DAC1 (TIM6) — TIM6 global, DAC1 Cahnnel1 and Cahnnel2 underrun error Interrupts
64 COMP1_2_3 (COMP) — COMP1_2_3 interrupt combined with EXTI lines 21, 22, 29
65 COMP4_5_6 (COMP) — COMP4_5_6 interrupt combined with EXTI lines 30, 31, 32
72 I2C3_EV_EXTI27_IRQ (I2C3) — I2C3 event interrupt & EXTI Line27 interrupt
73 I2C3_ER_IRQ (I2C3) — I2C3 error interrupt
76 USB_WKUP_EXTI (EXTI) — USB wakeup from Suspend and EXTI Line 18
81 FPU (EXTI) — Floating point unit interrupt
