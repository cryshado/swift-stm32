# STM32N657 register map
File version: 1.0
CPU: CM55 r0p1, little endian, no MPU, FPU, vendor SysTick, 8 interrupt priority bits
Registers are 32-bit, read-write, reset 0x0 unless marked. A register's access mark holds for its fields unless they carry their own. Offsets are from the block's base; [hi:lo] are bit positions; {n}, {i} and the like mark numbered series; 'fields as' and 'values as' point back to an identical list.

## VENC — Video encoder
Base 0x48005000
Same registers: VENC_S 0x58005000
0x00 SWREG0 reset 0x6E654000 — VENC ID register
  [31:0] SWREG_FIELD — Interrupt register (all format mode)
0x04 SWREG1 — VENC interrupt register
  [31:0] SWREG_FIELD — Interrupt register (all format mode)
0x08 SWREG2 reset 0x10 — VENC bus interface configuration register
  [31:0] SWREG_FIELD — Bus interface configuration register (all format mode)
0x0C SWREG3 — VENC device configuration register
  [31:0] SWREG_FIELD — Device configuration register (all format mode)
0x14 SWREG5 — VENC base address for output stream data register
  [31:0] SWREG_FIELD — Base address for output stream data (all format mode)
0x18 SWREG6 — VENC base address for output control data register
  [31:0] SWREG_FIELD — Base address for output control data (all format mode)
0x1C SWREG7 — VENC base address for reference luma register
  [31:0] SWREG_FIELD — Base address for reference luma (all format mode)
0x20 SWREG8 — VENC base address for reference chroma register
  [31:0] SWREG_FIELD — Base address for reference chroma (all format mode)
0x24 SWREG9 — VENC base address for reconstructed luma register
  [31:0] SWREG_FIELD — Base address for reconstructed luma (all format mode)
0x28 SWREG10 — VENC base address for reconstructed chroma register
  [31:0] SWREG_FIELD — Base address for reconstructed chroma (all format mode)
0x2C SWREG11 — VENC base address for input picture luma register
  [31:0] SWREG_FIELD — Base address for input picture luma (all format mode)
0x30 SWREG12 — VENC base address for input picture cb register
  [31:0] SWREG_FIELD — Base address for input picture cb (all format mode)
0x34 SWREG13 — VENC base address for input picture cr register
  [31:0] SWREG_FIELD — Base address for input picture cr (all format mode)
0x38 SWREG14 — VENC encoder control register 0
  [31:0] SWREG_FIELD — Encoder control register 0 (such as picture information or encoding mode) (all format mode)
0x3C SWREG15 — VENC encoder control register 1
  [31:0] SWREG_FIELD — Encoder control register 1 (such as preprocessing control, crop, rotate, input format) (all format mode)
0x40 SWREG16 — VENC encoder control register 2
  [31:0] SWREG_FIELD — Base address for second reference luma (H264 control) (all format mode)
0x44 SWREG17 — VENC encoder control register 3
  [31:0] SWREG_FIELD — Base address for second reference chroma (H264 control) (all format mode)
0x48 SWREG18 — VENC encoder control register 4
  [31:0] SWREG_FIELD — Encoder control register 4 (deblock filter mode, H264 control) (all format mode)
0x4C SWREG19 — VENC encoder control register 5
  [31:0] SWREG_FIELD — Encoder control register 5 (input format, motion vector etc) (all format mode)
0x50 SWREG20 — VENC encoder control register 6
  [31:0] SWREG_FIELD — Control of data JPEG (all format mode)
0x54 SWREG21 — VENC encoder control register 7
  [31:0] SWREG_FIELD — Control of H264 (all format mode)
0x58 SWREG22 — VENC stream header remainder MSB bits register
  [31:0] SWREG_FIELD — Stream header remainder bits MSB (MSB aligned) (all format mode)
0x5C SWREG23 — VENC stream header remainder LSB bits register
  [31:0] SWREG_FIELD — Stream header remainder bits LSB (MSB aligned) (all format mode)
0x60 SWREG24 — VENC stream buffer limit/output stream size register
  [31:0] SWREG_FIELD — Stream buffer limit (64-bit addresses)/output stream size (bits) (all format mode)
0x64 SWREG25 — VENC encoder control register 8
  [31:0] SWREG_FIELD — Control of MAD control and QP sum output (all format mode)
0x68 SWREG26 — VENC intra-slice bitmap register
  [31:0] SWREG_FIELD — intra-slice bitmap for probability updates (all format mode)
0x6C SWREG27 — VENC encoder control register 9
  [31:0] SWREG_FIELD — Control of H264 QP (all format mode)
0x70 SWREG28 — VENC encoder control register 10
  [31:0] SWREG_FIELD — H264 checkpoint 1-2 (all format mode)
0x74 SWREG29 — VENC encoder control register 11
  [31:0] SWREG_FIELD — H.264 Checkpoint 3 -4 (all format mode)
0x78 SWREG30 — VENC encoder control register 12
  [31:0] SWREG_FIELD — H.264 checkpoint 5 -6 (all format mode)
0x7C SWREG31 — VENC encoder control register 13
  [31:0] SWREG_FIELD — H.264 checkpoint 7 -8 (all format mode)
0x80 SWREG32 — VENC encoder control register 14
  [31:0] SWREG_FIELD — H.264 Checkpoint 8 -10 / Encoder control register 14 (all format mode)
0x84 SWREG33 — VENC encoder control register 15
  [31:0] SWREG_FIELD — H.264 Checkpoint word error 1-2 (all format mode)
0x88 SWREG34 — VENC encoder control register 16
  [31:0] SWREG_FIELD — H.264 checkpoint word error 3-4 and the second reference frame control (all format mode)
0x8C SWREG35 — VENC H.264 checkpoint word error 5-6/encoder control register 17
  [31:0] SWREG_FIELD — H.264 Checkpoint word error 5-6 / Encoder control register 17 (all format mode)
0x90 SWREG36 — VENC H.264 checkpoint delta QP 1-8/encoder control register 18
  [31:0] SWREG_FIELD — H.264 Checkpoint delta QP 1-8 / Encoder control register 18 (all format mode)
0x94 SWREG37 — VENC encoder control register 19, stream start offset
  [31:0] SWREG_FIELD — Encoder control register 19 (all format mode)
0x98 SWREG38 — VENC macroblock count output register
  [31:0] SWREG_FIELD — Macroblock count output (all format mode)
0x9C SWREG39 — VENC base address for next pic luminance register
  [31:0] SWREG_FIELD — Base address for next pic luminance (all format mode)
0xA0 SWREG40 — VENC stabilization mode control register
  [31:0] SWREG_FIELD — Stabilization mode control (all format mode)
0xA4 SWREG41 — VENC stabilization motion sum div8 output register
  [31:0] SWREG_FIELD — Stabilization motion sum div8 output (all format mode)
0xA8 SWREG42 — VENC stabilization GMV output, matrix 1, up-left position output register
  [31:0] SWREG_FIELD — Stabilization GMV output, matrix 1 (up-left position) output (all format mode)
0xAC SWREG43 — VENC stabilization GMV output, matrix 2, up position output register
  [31:0] SWREG_FIELD — Stabilization GMV output, matrix 2 (up position) output (all format mode)
0xB0 SWREG44 — VENC stabilization matrix 3, up-right position output register
  [31:0] SWREG_FIELD — Stabilization matrix 3 (up-right position) output (all format mode)
0xB4 SWREG45 — VENC stabilization matrix 4, left position output register
  [31:0] SWREG_FIELD — Stabilization matrix 4 (left position) output (all format mode)
0xB8 SWREG46 — VENC stabilization matrix 5, GMV position output register
  [31:0] SWREG_FIELD — Stabilization matrix 5 (GMV position) output (all format mode)
0xBC SWREG47 — VENC stabilization matrix 6, right position output register
  [31:0] SWREG_FIELD — Stabilization matrix 6 (right position) output (all format mode)
0xC0 SWREG48 — VENC stabilization matrix 7, down-left position output register
  [31:0] SWREG_FIELD — Stabilization matrix 7 (down-left position) output (all format mode)
0xC4 SWREG49 — VENC stabilization matrix 8, down position output register
  [31:0] SWREG_FIELD — Stabilization matrix 8 (down position) output (all format mode)
0xC8 SWREG50 — VENC stabilization matrix 9, down-right position output register
  [31:0] SWREG_FIELD — Stabilization matrix 9 (down-right position) output (all format mode)
0xCC SWREG51 — VENC base address for cabac context tables H264 register
  [31:0] SWREG_FIELD — Base address for cabac context tables (H264) or probability tables (all format mode)
0xD0 SWREG52 — VENC base address for MV output writing register
  [31:0] SWREG_FIELD — Base address for MV output writing (all format mode)
0xD4 SWREG53 — VENC RGB to YUV conversion coefficient A - B register
  [31:0] SWREG_FIELD — RGB to YUV conversion coefficient A - B (all format mode)
0xD8 SWREG54 — VENC RGB to YUV conversion coefficient C - E register
  [31:0] SWREG_FIELD — RGB to YUV conversion coefficient C - E (all format mode)
0xDC SWREG55 — VENC RGB to YUV conversion coefficient F, RGB mask MSB bit position register
  [31:0] SWREG_FIELD — RGB to YUV conversion coefficient F, RGB mask MSB bit position (all format mode)
0xE0 SWREG56 — VENC intra area register
  [31:0] SWREG_FIELD — intra area (all format mode)
0xE4 SWREG57 — VENC CIR intra mb position register
  [31:0] SWREG_FIELD — CIR intra mb position (all format mode)
0xE8 SWREG58 — VENC intra slice bitmap for slices 0..31/base address for 1st DCT partition register
  [31:0] SWREG_FIELD — intra slice bitmap for slices 0..31 / Base address for 1st DCT partition (all format mode)
0xEC SWREG59 — VENC intra slice bitmap for slices 32..63/base address for 2nd DCT partition register
  [31:0] SWREG_FIELD — intra slice bitmap for slices 32..63 / Base address for 2nd DCT partition (all format mode)
0xF0 SWREG60 — VENC 1st ROI area register
  [31:0] SWREG_FIELD — 1st ROI area (all format mode)
0xF4 SWREG61 — VENC 2nd ROI area register
  [31:0] SWREG_FIELD — 2nd ROI area (all format mode)
0xF8 SWREG62 — VENC ROI area delta QP, MV register
  [31:0] SWREG_FIELD — ROI area delta QP, MV (all format mode)
0xFC SWREG63 ro reset 0x1E622780 — VENC synthesis configuration register encoder 0 register
  [31:0] SWREG_FIELD — Synthesis configuration register encoder 0 (read only) (all format mode)
0x100 SWREG64 — VENC JPEG luma quantization 1/intra 16x16 mode 0-1 penalty register
  [31:0] SWREG_FIELD — JPEG luma quantization 1 / intra 16x16 mode 0-1 penalty (all format mode)
0x104 SWREG65 — VENC JPEG luma quantization 2/intra 16x16 mode 2-3 penalty register
  [31:0] SWREG_FIELD — JPEG luma quantization 2 / intra 16x16 mode 2-3 penalty (all format mode)
{0x0+4i} SWREG{i} (i=66..70) — VENC JPEG luma quantization {i-63}/intra 4x4 mode {2i-132}-{2i-131} penalty register
  [31:0] SWREG_FIELD — JPEG luma quantization {i-63} / intra 4x4 mode {2i-132}-{2i-131} penalty (all format mode)
0x11C SWREG71 — VENC JPEG luma quantization 8/base address for segmentation map register
  [31:0] SWREG_FIELD — JPEG luma quantization 8 / Base address for segmentation map (all format mode)
{0x0+4i} SWREG{i} (i=72..78) — VENC JPEG luma quantization {i-63}/segment1 parameter register
  [31:0] SWREG_FIELD — JPEG luma quantization {i-63} / segment1 parameter (all format mode)
0x13C SWREG79 — VENC JPEG luma quantization 16/segment2 parameter register
  [31:0] SWREG_FIELD — JPEG luma quantization 16 / segment2 parameter (all format mode)
{0x0+4i} SWREG{i} (i=80..87) — VENC JPEG chroma quantization {i-79}/segment2 parameter register
  [31:0] SWREG_FIELD — JPEG chroma quantization {i-79} / segment2 parameter (all format mode)
{0x0+4i} SWREG{i} (i=88..95) — VENC JPEG chroma quantization {i-79}/segment3 parameter register
  [31:0] SWREG_FIELD — JPEG chroma quantization {i-79} / segment3 parameter (all format mode)
0x180 SWREG96 wo — VENC DMV 4p/1p penalty values 0-3 register
  [31:0] SWREG_FIELD — DMV 4p/1p penalty values 0-3 (all format mode)
0x184 SWREG97 wo — VENC DMV 4p/1p penalty values 4-7 register
  [31:0] SWREG_FIELD — DMV 4p/1p penalty values 4-7 (all format mode)
{0x0+4i} SWREG{i} wo (i=98..126) — VENC DMV 4p/1p penalty values register
  [31:0] SWREG_FIELD — DMV 4p/1p penalty values (all format mode)
0x1FC SWREG127 wo — VENC DMV 4p/1p penalty values 124-127 register
  [31:0] SWREG_FIELD — DMV 4p/1p penalty values 124-127 (all format mode)
0x200 SWREG128 wo — VENC DMV qpel penalty values 0-3 register
  [31:0] SWREG_FIELD — DMV qpel penalty values 0-3 (all format mode)
0x204 SWREG129 wo — VENC DMV qpel penalty values 4-7 register
  [31:0] SWREG_FIELD — DMV qpel penalty values 4-7 (all format mode)
{0x0+4i} SWREG{i} wo (i=130..158) — VENC DMV qpel penalty values register
  [31:0] SWREG_FIELD — DMV qpel penalty values (all format mode)
0x27C SWREG159 wo — VENC DMV qpel penalty values 124-127 register
  [31:0] SWREG_FIELD — DMV qpel penalty values 124-127 (all format mode)
0x39C SWREG231 — VENC base address for output of down-scaled encoder image in YUYV 4:2:2 format register
  [31:0] SWREG_FIELD — Base address for output of down-scaled encoder image in YUYV 4:2:2 format (all format mode)
0x3A0 SWREG232 — VENC scaling control register
  [31:0] SWREG_FIELD — Scaling control (all format mode)
0x3A4 SWREG233 — VENC scaling control register
  [31:0] SWREG_FIELD — Scaling control (all format mode)
0x3B0 SWREG236 — VENC squared error output calculated for 13x13 pixels per macroblock register
  [31:0] SWREG_FIELD — Squared error output calculated for 13x13 pixels per macroblock (all format mode)
0x3B4 SWREG237 — VENC MAD 2 control and output register
  [31:0] SWREG_FIELD — MAD 2 control and output (all format mode)
0x3B8 SWREG238 — VENC MAD 3 control and output register
  [31:0] SWREG_FIELD — MAD 3 control and output (all format mode)
0x400 SWREG256 — VENC segment 1: intra 16x16 mode 0-2 penalty register
  [31:0] SWREG_FIELD — segment 1: intra 16x16 mode 0-2 penalty (all format mode)
0x404 SWREG257 — VENC segment 1: intra 16x16 mode 3, intra 4x4 0-1 penalty register
  [31:0] SWREG_FIELD — segment 1: intra 16x16 mode 3 and intra 4x4 0-1 penalty (all format mode)
0x408 SWREG258 — VENC segment 1: intra 4x4 mode 2-4 penalty register
  [31:0] SWREG_FIELD — segment 1: intra 4x4 mode 2-4 penalty (all format mode)
0x40C SWREG259 — VENC segment 1: intra 4x4 mode 5-7 penalty register
  [31:0] SWREG_FIELD — segment 1: intra 4x4 mode 5-7 penalty (all format mode)
0x410 SWREG260 — VENC segment 1: intra 4x4 mode 8-9 penalty, previous mode favor for H.264 register
  [31:0] SWREG_FIELD — segment 1: intra 4x4 mode 8-9 penalty, previous mode favor for H.264 (all format mode)
0x414 SWREG261 — VENC segment 1: bit cost of inter type, intra 16x16 mode favor register
  [31:0] SWREG_FIELD — segment 1: Bit cost of inter type, intra 16x16 mode favor (all format mode)
0x418 SWREG262 — VENC segment 1: inter MB mode favor, skip mode penalty, penalty value for 2nd reference frame register
  [31:0] SWREG_FIELD — segment 1: inter MB mode favor, skip mode penalty, penalty value for second reference frame (all format mode)
0x41C SWREG263 — VENC segment 1: penalty value register
  [31:0] SWREG_FIELD — segment 1: penalty value (all format mode)
0x420 SWREG264 — VENC segment 1: penalty value register
  [31:0] SWREG_FIELD — segment 1: penalty value (all format mode)
0x424 SWREG265 — VENC segment 1: deadzone rate multiplier for plane 0-1 register
  [31:0] SWREG_FIELD — segment 1: Deadzone rate multiplier for plane 0-1 (all format mode)
0x428 SWREG266 — VENC segment 1: deadzone rate multiplier for plane 2-3 register
  [31:0] SWREG_FIELD — segment 1: Deadzone rate multiplier for plane 2-3 (all format mode)
0x42C SWREG267 — VENC segment 1: deadzone rate for macroblock skip token 0-1, dmv penalty coefficient register
  [31:0] SWREG_FIELD — segment 1: Deadzone rate for macroblock skip token 0-1, dmv penalty coefficient (all format mode)
0x430 SWREG268 — VENC segment 2: intra 16x16 mode 0-2 penalty register
  [31:0] SWREG_FIELD — segment 2: intra 16x16 mode 0-2 penalty (all format mode)
0x434 SWREG269 — VENC segment 2: intra 16x16 mode 3 penalty, intra 4x4 mode 0-1 penalty register
  [31:0] SWREG_FIELD — segment 2: intra 16x16 mode 3 penalty, intra 4x4 mode 0-1 penalty (all format mode)
0x438 SWREG270 — VENC segment 2: intra 4x4 mode 2-4 penalty register
  [31:0] SWREG_FIELD — segment 2: intra 4x4 mode 2-4 penalty (all format mode)
0x43C SWREG271 — VENC segment 2: intra 4x4 mode 5-7 penalty register
  [31:0] SWREG_FIELD — segment 2: intra 4x4 mode 5-7 penalty (all format mode)
0x440 SWREG272 — VENC segment 2: intra 4x4 mode 8-9 penalty, intra 4x4 previous mode favor for H.264 register
  [31:0] SWREG_FIELD — segment 2: intra 4x4 mode 8-9 penalty, intra 4x4 previous mode favor for H.264 (all format mode)
0x444 SWREG273 — VENC segment 2: bit cost of inter type, intra 16x16 mode favor register
  [31:0] SWREG_FIELD — segment 2: Bit cost of inter type, intra 16x16 mode favor (all format mode)
0x448 SWREG274 — VENC segment 2: inter MB mode favor, skip mode penalty, penalty value register
  [31:0] SWREG_FIELD — segment 2: inter MB mode favor, skip mode penalty, panelty value (all format mode)
0x44C SWREG275 — VENC segment 2: penalty value register
  [31:0] SWREG_FIELD — segment 2: penalty value (all format mode)
0x450 SWREG276 — VENC segment 2: penalty value register
  [31:0] SWREG_FIELD — segment 2: penalty value (all format mode)
0x454 SWREG277 — VENC segment 2: deadzone rate multiplier for plane 0-1 register
  [31:0] SWREG_FIELD — segment 2: Deadzone rate multiplier for plane 0-1 (all format mode)
0x458 SWREG278 — VENC segment 2: deadzone rate multiplier for plane 2-3 register
  [31:0] SWREG_FIELD — segment 2: Deadzone rate multiplier for plane 2-3 (all format mode)
0x45C SWREG279 — VENC segment 2: deadzone rate for macroblock skip token 0-1, dmv penalty coefficient register
  [31:0] SWREG_FIELD — segment 2: Deadzone rate for macroblock skip token 0-1, dmv penalty coefficient (all format mode)
0x460 SWREG280 — VENC segment 3: intra 16x16 mode 0-2 penalty register
  [31:0] SWREG_FIELD — segment 3: intra 16x16 mode 0-2 penalty (all format mode)
0x464 SWREG281 — VENC segment 3: intra 16x16 mode 3 penalty, intra 4x4 mode 0-1 penalty register
  [31:0] SWREG_FIELD — segment 3: intra 16x16 mode 3 penalty, intra 4x4 mode 0-1 penalty (all format mode)
0x468 SWREG282 — VENC segment 3: intra 4x4 mode 2-4 penalty register
  [31:0] SWREG_FIELD — segment 3: intra 4x4 mode 2-4 penalty (all format mode)
0x46C SWREG283 — VENC segment 3: intra 4x4 mode 5-7 penalty register
  [31:0] SWREG_FIELD — segment 3: intra 4x4 mode 5-7 penalty (all format mode)
0x470 SWREG284 — VENC segment 3: intra 4x4 mode 8-9 penalty, intra 4x4 previous mode favor for H.264 register
  [31:0] SWREG_FIELD — segment 3: intra 4x4 mode 8-9 penalty, intra 4x4 previous mode favor for H.264 (all format mode)
0x474 SWREG285 — VENC segment 3: bit cost of inter type, intra 16x16 mode favor register
  [31:0] SWREG_FIELD — segment 3: Bit cost of inter type, intra 16x16 mode favor (all format mode)
0x478 SWREG286 — VENC segment 3: inter MB mode favor in intra/inter selection, inter MB mode favor, penalty value for second reference frame register
  [31:0] SWREG_FIELD — segment 3: inter MB mode favor in intra/inter selection, inter MB mode favor, penalty value for second reference frame (all format mode)
0x47C SWREG287 — VENC segment 3: penalty value register
  [31:0] SWREG_FIELD — segment 3: penalty value (all format mode)
0x480 SWREG288 — VENC segment 3: penalty value register
  [31:0] SWREG_FIELD — segment 3: penalty value (all format mode)
0x484 SWREG289 — VENC segment 3: deadzone rate multiplier for plane 0-1 register
  [31:0] SWREG_FIELD — segment 3: Deadzone rate multiplier for plane 0-1 (all format mode)
0x488 SWREG290 — VENC segment 3: deadzone rate multiplier for plane 2-3 register
  [31:0] SWREG_FIELD — segment 3: Deadzone rate multiplier for plane 2-3 (all format mode)
0x48C SWREG291 — VENC segment 3: deadzone rate for macroblock skip token 0-1, dmv penalty coefficient register
  [31:0] SWREG_FIELD — segment 3: Deadzone rate for macroblock skip token 0-1, dmv penalty coefficient (all format mode)
0x498 SWREG294 — VENC Mb boost register
  [31:0] SWREG_FIELD — Mb boost (all format mode)
0x49C SWREG295 — VENC variance control, Pskop conding mode register
  [31:0] SWREG_FIELD — Variance control, Pskop conding mode (all format mode)
0x4A0 SWREG296 ro reset 0x6800000 — VENC synthesis configuration register encoder 1 read only register
  [31:0] SWREG_FIELD — Synthesis configuration register encoder 1 (read only) (all format mode)
0x4A4 SWREG297 — VENC MBRC control register
  [31:0] SWREG_FIELD — MBRC control (all format mode)
0x4A8 SWREG298 — VENC segment 4: intra 4x4 previous mode favor, intra 16x16 mode favor, penalty value for second reference frame register
  [31:0] SWREG_FIELD — segment 4: intra 4x4 previous mode favor, intra 16x16 mode favor, penalty value for second reference frame (all format mode)
0x4AC SWREG299 — VENC segment 4: skip mode penalty, inter MB mode favor register
  [31:0] SWREG_FIELD — segment 4: skip mode penalty, inter MB mode favor (all format mode)
0x4B0 SWREG300 — VENC segment 4: penalty value register
  [31:0] SWREG_FIELD — segment 4: penalty value (all format mode)
0x4B4 SWREG301 — VENC segment 4: penalty value register
  [31:0] SWREG_FIELD — segment 4: penalty value (all format mode)
0x4B8 SWREG302 — VENC segment 5: intra 4x4 previous mode favor, intra 16x16 mode favor, penalty value for second reference frame register
  [31:0] SWREG_FIELD — segment 5: intra 4x4 previous mode favor, intra 16x16 mode favor, penalty value for second reference frame (all format mode)
0x4BC SWREG303 — VENC segment 5: skip mode penalty, inter MB mode favor register
  [31:0] SWREG_FIELD — segment 5: skip mode penalty, inter MB mode favor (all format mode)
0x4C0 SWREG304 — VENC segment 5: penalty value register
  [31:0] SWREG_FIELD — segment 5: penalty value (all format mode)
0x4C4 SWREG305 — VENC segment 5: penalty value register
  [31:0] SWREG_FIELD — segment 5: penalty value (all format mode)
0x4C8 SWREG306 — VENC segment 6: intra 4x4 previous mode favor, intra 16x16 mode favor, penalty value for second reference frame register
  [31:0] SWREG_FIELD — segment 6: intra 4x4 previous mode favor, intra 16x16 mode favor, penalty value for second reference frame (all format mode)
0x4CC SWREG307 — VENC segment 6: skip mode penalty, inter MB mode favor register
  [31:0] SWREG_FIELD — segment 6: skip mode penalty, inter MB mode favor (all format mode)
0x4D0 SWREG308 — VENC segment 6: penalty value register
  [31:0] SWREG_FIELD — segment 6: penalty value (all format mode)
0x4D4 SWREG309 — VENC segment 6: penalty value register
  [31:0] SWREG_FIELD — segment 6: penalty value (all format mode)
0x4D8 SWREG310 — VENC segment 7: intra 4x4 previous mode favor, intra 16x16 mode favor, penalty value for second reference frame register
  [31:0] SWREG_FIELD — segment 7: intra 4x4 previous mode favor, intra 16x16 mode favor, penalty value for second reference frame (all format mode)
0x4DC SWREG311 — VENC segment 7: skip mode penalty, inter MB mode favor register
  [31:0] SWREG_FIELD — segment 7: skip mode penalty, inter MB mode favor (all format mode)
0x4E0 SWREG312 — VENC segment 7: penalty value register
  [31:0] SWREG_FIELD — segment 7: penalty value (all format mode)
0x4E4 SWREG313 — VENC segment 7: penalty value register
  [31:0] SWREG_FIELD — segment 7: penalty value (all format mode)
0x4E8 SWREG314 — VENC segment 8: intra 4x4 previous mode favor, intra 16x16 mode favor, penalty value for second reference frame register
  [31:0] SWREG_FIELD — segment 8: intra 4x4 previous mode favor, intra 16x16 mode favor, penalty value for second reference frame (all format mode)
0x4EC SWREG315 — VENC segment 8: skip mode penalty, inter MB mode favor register
  [31:0] SWREG_FIELD — segment 8: skip mode penalty, inter MB mode favor (all format mode)
0x4F0 SWREG316 — VENC segment 8: penalty value register
  [31:0] SWREG_FIELD — segment 8: penalty value (all format mode)
0x4F4 SWREG317 — VENC segment 8: penalty value register
  [31:0] SWREG_FIELD — segment 8: penalty value (all format mode)
0x4F8 SWREG318 — VENC segment 9: intra 4x4 previous mode favor, intra 16x16 mode favor, penalty value for second reference frame register
  [31:0] SWREG_FIELD — segment 9: intra 4x4 previous mode favor, intra 16x16 mode favor, penalty value for second reference frame (all format mode)
0x4FC SWREG319 — VENC segment 9: skip mode penalty, inter MB mode favor register
  [31:0] SWREG_FIELD — segment 9: skip mode penalty, inter MB mode favor (all format mode)
0x500 SWREG320 — VENC segment 9: penalty value register
  [31:0] SWREG_FIELD — segment 9: penalty value (all format mode)
0x504 SWREG321 — VENC segment 9: penalty value register
  [31:0] SWREG_FIELD — segment 9: penalty value (all format mode)
0x508 SWREG322 — VENC segment 10: intra 4x4 previous mode favor, intra 16x16 mode favor, penalty value for second reference frame register
  [31:0] SWREG_FIELD — segment 10: intra 4x4 previous mode favor, intra 16x16 mode favor, penalty value for second reference frame (all format mode)
0x50C SWREG323 — VENC segment 10: skip mode penalty, inter MB mode favor register
  [31:0] SWREG_FIELD — segment 10: skip mode penalty, inter MB mode favor (all format mode)
0x510 SWREG324 — VENC segment 10: penalty value register
  [31:0] SWREG_FIELD — segment 10: penalty value (all format mode)
0x514 SWREG325 — VENC segment 10: penalty value register
  [31:0] SWREG_FIELD — segment 10: penalty value (all format mode)
0x518 SWREG326 — VENC segment 11: intra 4x4 previous mode favor, intra 16x16 mode favor, penalty value for second reference frame register
  [31:0] SWREG_FIELD — segment 11: intra 4x4 previous mode favor, intra 16x16 mode favor, penalty value for second reference frame (all format mode)
0x51C SWREG327 — VENC segment 11: skip mode penalty, inter MB mode favor register
  [31:0] SWREG_FIELD — segment 11: skip mode penalty, inter MB mode favor (all format mode)
0x520 SWREG328 — VENC segment 11: penalty value register
  [31:0] SWREG_FIELD — segment 11: penalty value (all format mode)
0x524 SWREG329 — VENC segment 11: penalty value register
  [31:0] SWREG_FIELD — segment 11: penalty value (all format mode)
0x528 SWREG330 — VENC segment 12: intra 4x4 previous mode favor, intra 16x16 mode favor, penalty value for second reference frame register
  [31:0] SWREG_FIELD — segment 12: intra 4x4 previous mode favor, intra 16x16 mode favor, penalty value for second reference frame (all format mode)
0x52C SWREG331 — VENC segment 12: skip mode penalty, inter MB mode favor register
  [31:0] SWREG_FIELD — segment 12: skip mode penalty, inter MB mode favor (all format mode)
0x530 SWREG332 — VENC segment 12: penalty value register
  [31:0] SWREG_FIELD — segment 12: penalty value (all format mode)
0x534 SWREG333 — VENC segment 12: penalty value register
  [31:0] SWREG_FIELD — segment 12: penalty value (all format mode)
0x538 SWREG334 — VENC segment 13: intra 4x4 previous mode favor, intra 16x16 mode favor, penalty value for second reference frame register
  [31:0] SWREG_FIELD — segment 13: intra 4x4 previous mode favor, intra 16x16 mode favor, penalty value for second reference frame (all format mode)
0x53C SWREG335 — VENC segment 13: skip mode penalty, inter MB mode favor register
  [31:0] SWREG_FIELD — segment 13: skip mode penalty, inter MB mode favor (all format mode)
0x540 SWREG336 — VENC segment 13: penalty value register
  [31:0] SWREG_FIELD — segment 13: penalty value (all format mode)
0x544 SWREG337 — VENC segment 13: penalty value register
  [31:0] SWREG_FIELD — segment 13: penalty value (all format mode)
0x548 SWREG338 — VENC segment 14: intra 4x4 previous mode favor, intra 16x16 mode favor, penalty value for second reference frame register
  [31:0] SWREG_FIELD — segment 14: intra 4x4 previous mode favor, intra 16x16 mode favor, penalty value for second reference frame (all format mode)
0x54C SWREG339 — VENC segment 14: skip mode penalty, inter MB mode favor register
  [31:0] SWREG_FIELD — segment 14: skip mode penalty, inter MB mode favor (all format mode)
0x550 SWREG340 — VENC segment 14: penalty value register
  [31:0] SWREG_FIELD — segment 14: penalty value (all format mode)
0x554 SWREG341 — VENC segment 14: penalty value register
  [31:0] SWREG_FIELD — segment 14: penalty value (all format mode)
0x558 SWREG342 — VENC segment 15: intra 4x4 previous mode favor, intra 16x16 mode favor, penalty value for second reference frame register
  [31:0] SWREG_FIELD — segment 15: intra 4x4 previous mode favor, intra 16x16 mode favor, penalty value for second reference frame (all format mode)
0x55C SWREG343 — VENC segment 15: skip mode penalty, inter MB mode favor register
  [31:0] SWREG_FIELD — segment 15: skip mode penalty, inter MB mode favor (all format mode)
0x560 SWREG344 — VENC segment 15: penalty value register
  [31:0] SWREG_FIELD — segment 15: penalty value (all format mode)
0x564 SWREG345 — VENC segment 15: penalty value register
  [31:0] SWREG_FIELD — segment 15: penalty value (all format mode)
0x568 SWREG346 — VENC segment 16: intra 4x4 previous mode favor, intra 16x16 mode favor, penalty value for second reference frame register
  [31:0] SWREG_FIELD — segment 16: intra 4x4 previous mode favor, intra 16x16 mode favor, penalty value for second reference frame (all format mode)
0x56C SWREG347 — VENC segment 16: skip mode penalty, inter MB mode favor register
  [31:0] SWREG_FIELD — segment 16: skip mode penalty, inter MB mode favor (all format mode)
0x570 SWREG348 — VENC segment 16: penalty value register
  [31:0] SWREG_FIELD — segment 16: penalty value (all format mode)
0x574 SWREG349 — VENC segment 16: penalty value register
  [31:0] SWREG_FIELD — segment 16: penalty value (all format mode)
0x578 SWREG350 — VENC segment 17: intra 4x4 previous mode favor, intra 16x16 mode favor, penalty value for second reference frame register
  [31:0] SWREG_FIELD — segment 17: intra 4x4 previous mode favor, intra 16x16 mode favor, penalty value for second reference frame (all format mode)
0x57C SWREG351 — VENC segment 17: skip mode penalty, inter MB mode favor register
  [31:0] SWREG_FIELD — segment 17: skip mode penalty, inter MB mode favor (all format mode)
0x580 SWREG352 — VENC segment 17: penalty value register
  [31:0] SWREG_FIELD — segment 17: penalty value (all format mode)
0x584 SWREG353 — VENC segment 17: penalty value register
  [31:0] SWREG_FIELD — segment 17: penalty value (all format mode)
0x588 SWREG354 — VENC segment 18: intra 4x4 previous mode favor, intra 16x16 mode favor, penalty value for second reference frame register
  [31:0] SWREG_FIELD — segment 18: intra 4x4 previous mode favor, intra 16x16 mode favor, penalty value for second reference frame (all format mode)
0x58C SWREG355 — VENC segment 18: skip mode penalty, inter MB mode favor register
  [31:0] SWREG_FIELD — segment 18: skip mode penalty, inter MB mode favor (all format mode)
0x590 SWREG356 — VENC segment 18: penalty value register
  [31:0] SWREG_FIELD — segment 18: penalty value (all format mode)
0x594 SWREG357 — VENC segment 18: penalty value register
  [31:0] SWREG_FIELD — segment 18: penalty value (all format mode)
0x598 SWREG358 — VENC segment 19: intra 4x4 previous mode favor, intra 16x16 mode favor, penalty value for second reference frame register
  [31:0] SWREG_FIELD — segment 19: intra 4x4 previous mode favor, intra 16x16 mode favor, penalty value for second reference frame (all format mode)
0x59C SWREG359 — VENC segment 19: skip mode penalty, inter MB mode favor register
  [31:0] SWREG_FIELD — segment 19: skip mode penalty, inter MB mode favor (all format mode)
0x5A0 SWREG360 — VENC segment 19: penalty value register
  [31:0] SWREG_FIELD — segment 19: penalty value (all format mode)
0x5A4 SWREG361 — VENC segment 19: penalty value register
  [31:0] SWREG_FIELD — segment 19: penalty value (all format mode)
0x5A8 SWREG362 — VENC segment 20: intra 4x4 previous mode favor, intra 16x16 mode favor, penalty value for second reference frame register
  [31:0] SWREG_FIELD — segment 20: intra 4x4 previous mode favor, intra 16x16 mode favor, penalty value for second reference frame (all format mode)
0x5AC SWREG363 — VENC segment 20: skip mode penalty, inter MB mode favor register
  [31:0] SWREG_FIELD — segment 20: skip mode penalty, inter MB mode favor (all format mode)
0x5B0 SWREG364 — VENC segment 20: penalty value register
  [31:0] SWREG_FIELD — segment 20: penalty value (all format mode)
0x5B4 SWREG365 — VENC segment 20: penalty value register
  [31:0] SWREG_FIELD — segment 20: penalty value (all format mode)
0x5B8 SWREG366 — VENC segment 21: intra 4x4 previous mode favor, intra 16x16 mode favor, penalty value for second reference frame register
  [31:0] SWREG_FIELD — segment 21: intra 4x4 previous mode favor, intra 16x16 mode favor, penalty value for second reference frame (all format mode)
0x5BC SWREG367 — VENC segment 21: skip mode penalty, inter MB mode favor register
  [31:0] SWREG_FIELD — segment 21: skip mode penalty, inter MB mode favor (all format mode)
0x5C0 SWREG368 — VENC segment 21: penalty value register
  [31:0] SWREG_FIELD — segment 21: penalty value (all format mode)
0x5C4 SWREG369 — VENC segment 21: penalty value register
  [31:0] SWREG_FIELD — segment 21: penalty value (all format mode)
0x5C8 SWREG370 — VENC segment 22: intra 4x4 previous mode favor, intra 16x16 mode favor, penalty value for second reference frame register
  [31:0] SWREG_FIELD — segment 22: intra 4x4 previous mode favor, intra 16x16 mode favor, penalty value for second reference frame (all format mode)
0x5CC SWREG371 — VENC segment 22: skip mode penalty, inter MB mode favor register
  [31:0] SWREG_FIELD — segment 22: skip mode penalty, inter MB mode favor (all format mode)
0x5D0 SWREG372 — VENC segment 22: penalty value register
  [31:0] SWREG_FIELD — segment 22: penalty value (all format mode)
0x5D4 SWREG373 — VENC segment 22: penalty value register
  [31:0] SWREG_FIELD — segment 22: penalty value (all format mode)
0x5D8 SWREG374 — VENC segment 23: intra 4x4 previous mode favor, intra 16x16 mode favor, penalty value for second reference frame register
  [31:0] SWREG_FIELD — segment 23: intra 4x4 previous mode favor, intra 16x16 mode favor, penalty value for second reference frame (all format mode)
0x5DC SWREG375 — VENC segment 23: skip mode penalty, inter MB mode favor register
  [31:0] SWREG_FIELD — segment 23: skip mode penalty, inter MB mode favor (all format mode)
0x5E0 SWREG376 — VENC segment 23: penalty value register
  [31:0] SWREG_FIELD — segment 23: penalty value (all format mode)
0x5E4 SWREG377 — VENC segment 23: penalty value register
  [31:0] SWREG_FIELD — segment 23: penalty value (all format mode)
0x5E8 SWREG378 — VENC segment 24: intra 4x4 previous mode favor, intra 16x16 mode favor, penalty value for second reference frame register
  [31:0] SWREG_FIELD — segment 24: intra 4x4 previous mode favor, intra 16x16 mode favor, penalty value for second reference frame (all format mode)
0x5EC SWREG379 — VENC segment 24: skip mode penalty, inter MB mode favor register
  [31:0] SWREG_FIELD — segment 24: skip mode penalty, inter MB mode favor (all format mode)
0x5F0 SWREG380 — VENC segment 24: penalty value register
  [31:0] SWREG_FIELD — segment 24: penalty value (all format mode)
0x5F4 SWREG381 — VENC segment 24: penalty value register
  [31:0] SWREG_FIELD — segment 24: penalty value (all format mode)
0x5F8 SWREG382 — VENC segment 25: intra 4x4 previous mode favor, intra 16x16 mode favor, penalty value for second reference frame register
  [31:0] SWREG_FIELD — segment 25: intra 4x4 previous mode favor, intra 16x16 mode favor, penalty value for second reference frame (all format mode)
0x5FC SWREG383 — VENC segment 25: skip mode penalty, inter MB mode favor register
  [31:0] SWREG_FIELD — segment 25: skip mode penalty, inter MB mode favor (all format mode)
0x600 SWREG384 — VENC segment 25: penalty value register
  [31:0] SWREG_FIELD — segment 25: penalty value (all format mode)
0x604 SWREG385 — VENC segment 25: penalty value register
  [31:0] SWREG_FIELD — segment 25: penalty value (all format mode)
0x608 SWREG386 — VENC segment 26: intra 4x4 previous mode favor, intra 16x16 mode favor, penalty value for second reference frame register
  [31:0] SWREG_FIELD — segment 26: intra 4x4 previous mode favor, intra 16x16 mode favor, penalty value for second reference frame (all format mode)
0x60C SWREG387 — VENC segment 26: skip mode penalty, inter MB mode favor register
  [31:0] SWREG_FIELD — segment 26: skip mode penalty, inter MB mode favor (all format mode)
0x610 SWREG388 — VENC segment 26: penalty value register
  [31:0] SWREG_FIELD — segment 26: penalty value (all format mode)
0x614 SWREG389 — VENC segment 26: penalty value register
  [31:0] SWREG_FIELD — segment 26: penalty value (all format mode)
0x618 SWREG390 — VENC segment 27: intra 4x4 previous mode favor, intra 16x16mode favor, penalty value for second reference frame register
  [31:0] SWREG_FIELD — segment 27: intra 4x4 previous mode favor, intra 16x16 mode favor, penalty value for second reference frame (all format mode)
0x61C SWREG391 — VENC segment 27: skip mode penalty, inter MB mode favor register
  [31:0] SWREG_FIELD — segment 27: skip mode penalty, inter MB mode favor (all format mode)
0x620 SWREG392 — VENC segment 27: penalty value register
  [31:0] SWREG_FIELD — segment 27: penalty value (all format mode)
0x624 SWREG393 — VENC segment 27: penalty value register
  [31:0] SWREG_FIELD — segment 27: penalty value (all format mode)
0x628 SWREG394 — VENC segment 28: intra 4x4 previous mode favor, intra 16x16mode favor, penalty value for second reference frame register
  [31:0] SWREG_FIELD — segment 28: intra 4x4 previous mode favor, intra 16x16 mode favor, penalty value for second reference frame (all format mode)
0x62C SWREG395 — VENC segment 28: skip mode penalty, inter MB mode favor register
  [31:0] SWREG_FIELD — segment 28: skip mode penalty, inter MB mode favor (all format mode)
0x630 SWREG396 — VENC segment 28: penalty value register
  [31:0] SWREG_FIELD — segment 28: penalty value (all format mode)
0x634 SWREG397 — VENC segment 28: penalty value register
  [31:0] SWREG_FIELD — segment 28: penalty value (all format mode)
0x638 SWREG398 — VENC segment 29: intra 4x4 previous mode favor, intra 16x16 mode favor, penalty value for second reference frame register
  [31:0] SWREG_FIELD — segment 29: intra 4x4 previous mode favor, intra 16x16 mode favor, penalty value for second reference frame (all format mode)
0x63C SWREG399 — VENC segment 29: skip mode penalty, inter MB mode favor register
  [31:0] SWREG_FIELD — segment 29: skip mode penalty, inter MB mode favor (all format mode)
0x640 SWREG400 — VENC segment 29: penalty value register
  [31:0] SWREG_FIELD — segment 29: penalty value (all format mode)
0x644 SWREG401 — VENC segment 29: penalty value register
  [31:0] SWREG_FIELD — segment 29: penalty value (all format mode)
0x648 SWREG402 — VENC segment 30: intra 4x4 previous mode favor, intra 16x16 mode favor, penalty value for second reference frame register
  [31:0] SWREG_FIELD — segment 30: intra 4x4 previous mode favor, intra 16x16 mode favor, penalty value for second reference frame (all format mode)
0x64C SWREG403 — VENC segment 30: skip mode penalty, inter MB mode favor register
  [31:0] SWREG_FIELD — segment 30: skip mode penalty, inter MB mode favor (all format mode)
0x650 SWREG404 — VENC segment 30: penalty value register
  [31:0] SWREG_FIELD — segment 30: penalty value (all format mode)
0x654 SWREG405 — VENC segment 30: penalty value register
  [31:0] SWREG_FIELD — segment 30: penalty value (all format mode)
0x658 SWREG406 — VENC segment 31: intra 4x4 previous mode favor, intra 16x16 mode favor, penalty value for second reference frame register
  [31:0] SWREG_FIELD — segment 31: intra 4x4 previous mode favor, intra 16x16 mode favor, penalty value for second reference frame (all format mode)
0x65C SWREG407 — VENC segment 31: skip mode penalty, inter MB mode favor register
  [31:0] SWREG_FIELD — segment 31: skip mode penalty, inter MB mode favor (all format mode)
0x660 SWREG408 — VENC segment 31: penalty value register
  [31:0] SWREG_FIELD — segment 31: penalty value (all format mode)
0x664 SWREG409 — VENC segment 31: penalty value register
  [31:0] SWREG_FIELD — segment 31: penalty value (all format mode)
0x668 SWREG410 — VENC MBRC control, QP, offset, enable register
  [31:0] SWREG_FIELD — MBRC control (QP, offset, enable) (all format mode)
0x66C SWREG411 — VENC gain of MB QP delta. 8.8 format register
  [31:0] SWREG_FIELD — gain of MB QPdelta. 8.8 format (all format mode)
0x670 SWREG412 — VENC average of MB complexity register
  [31:0] SWREG_FIELD — average of MB complexity (all format mode)
0x674 SWREG413 — VENC reference compression control register
  [31:0] SWREG_FIELD — average of MB complexity (all format mode)
0x678 SWREG414 — VENC base address for reference luma register
  [31:0] SWREG_FIELD — average of MB complexity (all format mode)
0x67C SWREG415 — VENC base address for reference chroma register
  [31:0] SWREG_FIELD — average of MB complexity (all format mode)
0x680 SWREG416 — VENC base address for reconstructed luma register
  [31:0] SWREG_FIELD — average of MB complexity (all format mode)
0x684 SWREG417 — VENC base address for reconstructed chroma register
  [31:0] SWREG_FIELD — average of MB complexity (all format mode)
0x688 SWREG418 — VENC base address for second reference luma register
  [31:0] SWREG_FIELD — average of MB complexity (all format mode)
0x68C SWREG419 — VENC base address for second reference chroma register
  [31:0] SWREG_FIELD — average of MB complexity (all format mode)
0x690 SWREG420 — VENC limit of chroma RFC buffer register
  [31:0] SWREG_FIELD — average of MB complexity (all format mode)
0x694 SWREG421 — VENC reorder control register
  [31:0] SWREG_FIELD — Reorder control (all format mode)
0x698 SWREG422 — VENC AXI read ID register
  [31:0] SWREG_FIELD — AXI Read ID (all format mode)
0x69C SWREG423 — VENC base address MSB for reference luma compression table register
  [31:0] SWREG_FIELD — AXI Read ID (all format mode)
0x6A0 SWREG424 — VENC base address MSB for reference chroma compression table register
  [31:0] SWREG_FIELD — AXI Read ID (all format mode)
0x6A4 SWREG425 — VENC base address MSB for reconstructed luma compression table register
  [31:0] SWREG_FIELD — AXI Read ID (all format mode)
0x6A8 SWREG426 — VENC base address for reconstructed chroma compression table register
  [31:0] SWREG_FIELD — Base address for reconstructed chroma compression table (all format mode)
0x6AC SWREG427 — VENC base address MSB for second reference luma compression table register
  [31:0] SWREG_FIELD — Base address MSB for second reference luma compression table (all format mode)
0x6B0 SWREG428 — VENC base address MSB for second reference chroma compression table register
  [31:0] SWREG_FIELD — Base address MSB for second reference chroma compression table (all format mode)
0x6B4 SWREG429 — VENC high 32 bits of base address for output stream data register
  [31:0] SWREG_FIELD — high 32 bits of Base address for output stream data (all format mode)
0x6B8 SWREG430 — VENC high 32 bits of base address for output control data register
  [31:0] SWREG_FIELD — high 32 bits of Base address for output control data (all format mode)
0x6BC SWREG431 — VENC high 32 bits of base address for reference luma register
  [31:0] SWREG_FIELD — high 32 bits of Base address for reference luma (all format mode)
0x6C0 SWREG432 — VENC high 32 bits of base address for reference chroma register
  [31:0] SWREG_FIELD — high 32 bits of Base address for reference chroma (all format mode)
0x6C4 SWREG433 — VENC high 32 bits of base address for reconstructed luma register
  [31:0] SWREG_FIELD — high 32 bits of Base address for reconstructed luma (all format mode)
0x6C8 SWREG434 — VENC high 32 bits of base address for reconstructed chroma register
  [31:0] SWREG_FIELD — high 32 bits of Base address for reconstructed chroma (all format mode)
0x6CC SWREG435 — VENC high 32 bits of base address for input picture luma register
  [31:0] SWREG_FIELD — high 32 bits of Base address for input picture luma (all format mode)
0x6D0 SWREG436 — VENC high 32 bits of base address for input picture cb register
  [31:0] SWREG_FIELD — high 32 bits of Base address for input picture cb (all format mode)
0x6D4 SWREG437 — VENC high 32 bits of base address for input picture cr register
  [31:0] SWREG_FIELD — high 32 bits of Base address for input picture cr (all format mode)
0x6D8 SWREG438 — VENC high 32 bits of base address for second reference luma register
  [31:0] SWREG_FIELD — high 32 bits of Base address for second reference luma (all format mode)
0x6DC SWREG439 — VENC high 32 bits of base address for second reference chroma register
  [31:0] SWREG_FIELD — high 32 bits of Base address for second reference chroma (all format mode)
0x6E0 SWREG440 — VENC high 32 bits of H264 secondary ref pic base register
  [31:0] SWREG_FIELD — high 32 bits of H264 secondary ref pic base (all format mode)
0x6E4 SWREG441 — VENC high 32 bits of H264 secondary ref pic base register
  fields as SWREG440
0x6E8 SWREG442 — VENC high 32 bits of base address for next pic luminance register
  [31:0] SWREG_FIELD — high 32 bits of Base address for next pic luminance (all format mode)
0x6EC SWREG443 — VENC high 32 bits of base address for cabac context tables H264 register
  [31:0] SWREG_FIELD — high 32 bits of Base address for cabac context tables (H264) or probability tables (all format mode)
0x6F0 SWREG444 — VENC high 32 bits of base address for MV output writing register
  [31:0] SWREG_FIELD — high 32 bits of Base address for MV output writing (all format mode)
0x704 SWREG449 — VENC high 32 bits of base address for output of down-scaled encoder image in YUYV 4:2:2 format register
  [31:0] SWREG_FIELD — high 32 bits of Base address for output of down-scaled encoder image in YUYV 4:2:2 format (all format mode)
0x7C4 SWREG497 — VENC low-latency control register
  [31:0] SWREG_FIELD — Low latency control (all format mode)
0x7C8 SWREG498 — VENC encoder line buffer offset register
  [31:0] SWREG_FIELD — Low latency control (all format mode)
