# STM32F410 register map
File version: 1.8
CPU: CM4 r0p1, little endian, MPU, FPU, 4 interrupt priority bits
Registers are 32-bit, read-write, reset 0x0 unless marked. A register's access mark holds for its fields unless they carry their own. Offsets are from the block's base; lines under a group give offsets from that group; [hi:lo] are bit positions; {n}, {i} and the like mark numbered series; 'fields as' and 'values as' point back to an identical list; <NAME> marks a mode.

## Memory map
0x40000C00 TIM5 size 0x400 — General-purpose-timers
0x40001000 TIM6 size 0x400 — Basic timers
0x40002400 LPTIM1 size 0x400 — Low power timer
0x40002800 RTC size 0x400 — Real-time clock
0x40002C00 WWDG size 0x400 — Window watchdog
0x40003000 IWDG size 0x400 — Independent watchdog
0x40003800 SPI2 size 0x400
0x40004400 USART2 size 0x400
0x40005400 I2C1 size 0x400 — Inter-integrated circuit
0x40005800 I2C2 size 0x400
0x40006000 FMPI2C1 size 0x400 — Inter-integrated circuit
0x40007000 PWR size 0x400 — Power control
0x40007400 DAC size 0x400 — Digital-to-analog converter
0x40010000 TIM1 size 0x400 — Advanced-timers
0x40010400 TIM8 size 0x400
0x40011000 USART1 size 0x400 — Universal synchronous asynchronous receiver transmitter
0x40011400 USART6 size 0x400
0x40012000 ADC1 size 0x51 — Analog-to-digital converter
0x40012300 ADC_Common size 0x9 — ADC common registers
0x40013000 SPI1 size 0x400 — Serial peripheral interface
0x40013800 SYSCFG size 0x400 — System configuration controller
0x40013C00 EXTI size 0x400 — External interrupt/event controller
0x40014000 TIM9 size 0x400 — General purpose timers
0x40014800 TIM11 size 0x400 — General-purpose-timers
0x40015000 SPI5 size 0x400
0x40020000 GPIOA size 0x400 — General-purpose I/Os
0x40020400 GPIOB size 0x400 — General-purpose I/Os
0x40020800 GPIOC size 0x400
0x40021C00 GPIOH size 0x400 — General-purpose I/Os
0x40023000 CRC size 0x400 — Cryptographic processor
0x40023800 RCC size 0x400 — Reset and clock control
0x40023C00 FLASH size 0x400
0x40026000 DMA1 size 0x400 — DMA controller
0x40026400 DMA2 size 0x400
0x40080000 RNG size 0x400 — Random number generator
0xE0042000 DBGMCU size 0x400 — Debug support

## Interrupts
0 WWDG — Window watchdog interrupt
1 PVD (PWR) — PVD through EXTI line detection interrupt
2 TAMP_STAMP (EXTI) — Tamper and TimeStamp interrupts through the EXTI line
3 RTC_WKUP (RTC) — RTC Wakeup interrupt through the EXTI line
4 FLASH — FLASH global interrupt
5 RCC — RCC global interrupt
6 EXTI0 (EXTI) — EXTI Line0 interrupt
7 EXTI1 (EXTI) — EXTI Line1 interrupt
8 EXTI2 (EXTI) — EXTI Line2 interrupt
9 EXTI3 (EXTI) — EXTI Line3 interrupt
10 EXTI4 (EXTI) — EXTI Line4 interrupt
11 DMA1_Stream0 (DMA1) — DMA1 Stream0 global interrupt
12 DMA1_Stream1 (DMA1) — DMA1 Stream1 global interrupt
13 DMA1_Stream2 (DMA1) — DMA1 Stream2 global interrupt
14 DMA1_Stream3 (DMA1) — DMA1 Stream3 global interrupt
15 DMA1_Stream4 (DMA1) — DMA1 Stream4 global interrupt
16 DMA1_Stream5 (DMA1) — DMA1 Stream5 global interrupt
17 DMA1_Stream6 (DMA1) — DMA1 Stream6 global interrupt
18 ADC (ADC1) — ADC1 global interrupt
23 EXTI9_5 (EXTI) — EXTI Line[9:5] interrupts
24 TIM1_BRK_TIM9 (TIM1) — TIM1 Break interrupt and TIM9 global interrupt
25 PWM1_UP (TIM1) — Timer1 Update interrupt
26 TIM1_TRG_COM_TIM11 (TIM1) — TIM1 Trigger and Commutation interrupts and TIM11 global interrupt
27 TIM1_CC (TIM1) — TIM1 Capture Compare interrupt
31 I2C1_EV (I2C1) — I2C1 event interrupt
32 I2C1_ER (I2C1) — I2C1 error interrupt
33 I2C2_EV (I2C2) — I2C2 event interrupt
34 I2C2_ER (I2C2) — I2C2 error interrupt
35 SPI1 — SPI1 global interrupt
36 SPI2 — SPI2 global interrupt
37 USART1 — USART1 global interrupt
38 USART2 — USART2 global interrupt
40 EXTI15_10 (EXTI) — EXTI Line[15:10] interrupts
41 RTC_Alarm (DMA1) — RTC Alarms (A and B) through EXTI line interrupt
47 DMA1_Stream7 (DMA1) — DMA1 Stream7 global interrupt
50 TIM5 — TIM5 global interrupt
54 TIM6_DAC1 (TIM6) — Timer6 and DAC1 global interrupt
56 DMA2_Stream0 (DMA2) — DMA2 Stream0 global interrupt
57 DMA2_Stream1 (DMA2) — DMA2 Stream1 global interrupt
58 DMA2_Stream2 (DMA2) — DMA2 Stream2 global interrupt
59 DMA2_Stream3 (DMA2) — DMA2 Stream3 global interrupt
60 DMA2_Stream4 (DMA2) — DMA2 Stream4 global interrupt
62 EXTI19 (EXTI) — EXTI Line 19 interrupt
68 DMA2_Stream5 (DMA2) — DMA2 Stream5 global interrupt
69 DMA2_Stream6 (DMA2) — DMA2 Stream6 global interrupt
70 DMA2_Stream7 (DMA2) — DMA2 Stream7 global interrupt
71 USART6 — USART6 global interrupt
76 EXTI20 (EXTI) — EXTI Line 20 interrupt
80 RNG — RNG global interrupt
81 FPU (EXTI) — Floating point unit interrupt
85 SPI5 — SPI 5 global interrupt
95 I2C4_EV (FMPI2C1) — I2C4 event interrupt
96 I2C4_ER (FMPI2C1) — I2C2 error interrupt
97 LPTIM1 — LPTimer global interrupt
